## Kconfig.defconfig
```kconfig
# Copyright (c) 2019 Linaro Limited
# SPDX-License-Identifier: Apache-2.0

if BOARD_ESP32_DEV_ESP32_PROCPU

if DISPLAY

if LVGL

config LV_Z_VDB_SIZE
	default 64

config LV_DPI_DEF
	default 116 if SHIELD_SH1106_128X64
	default 148

config LV_Z_BITS_PER_PIXEL
	default 1

config LV_Z_COLOR_MONO_HW_INVERSION
	default y

choice LV_COLOR_DEPTH
	default LV_COLOR_DEPTH_1
endchoice

endif # LVGL

endif # DISPLAY

endif # BOARD_ESP32_DEV_ESP32_PROCPU
```

## Kconfig.esp32_dev
```kconfig
# Copyright (c) 2023-2025 Espressif Systems (Shanghai) Co., Ltd.
# SPDX-License-Identifier: Apache-2.0

config BOARD_ESP32_DEV
	select SOC_ESP32_D0WD_V3
	select SOC_ESP32_PROCPU if BOARD_ESP32_DEV_ESP32_PROCPU
```

## board.yml
```yaml
board:
  name: esp32_dev
  full_name: ESP32-Dev-Board
  vendor: espressif
  socs:
  - name: esp32
```

## esp32_dev_appcpu_defconfig
```kconfig
# SPDX-License-Identifier: Apache-2.0

CONFIG_CLOCK_CONTROL=y
CONFIG_ESP32_USE_UNSUPPORTED_REVISION=y
```

## esp32_dev_procpu_defconfig
```kconfig
# Copyright (c) 2023-2025 Espressif Systems (Shanghai) Co., Ltd.
# SPDX-License-Identifier: Apache-2.0

CONFIG_CONSOLE=y
CONFIG_SERIAL=y
CONFIG_UART_CONSOLE=y

CONFIG_GPIO=y

CONFIG_ESP32_WIFI_IRAM_OPT=y
CONFIG_ESP32_WIFI_RX_IRAM_OPT=y

CONFIG_ESP32_REGION_1_NOINIT=y
CONFIG_ESP32_USE_UNSUPPORTED_REVISION=y
```
